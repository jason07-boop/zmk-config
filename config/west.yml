## config/west.yml
```yaml
manifest:
  remotes:
    - name: zmkfirmware
      url-base: https://github.com/zmkfirmware
    # Additional modules containing boards/shields/custom code can be listed here as well
    # See https://docs.zephyrproject.org/3.2.0/develop/west/manifest.html#projects
    - name: m165437
      url-base: https://github.com/M165437
    - name: jason07-boop
      url-base: https://github.com/jason07-boop
  projects:
    - name: zmk
      remote: zmkfirmware
      revision: main
      import: app/west.yml
    - name: nice-view-gem
      remote: m165437
      revision: main
      path: nice-view-gem
    - name: zmk-feature-appcompanion
      remote: jason07-boop
      revision: main
  self:
    path: config
    
```
